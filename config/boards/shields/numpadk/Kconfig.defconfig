## config/boards/shields/numpadk/Kconfig.defconfig
```kconfig
if SHIELD_NUMPADK

config ZMK_KEYBOARD_NAME
    default "NumPad"
endif

if ZMK_DISPLAY

config LPM009M360A
	default y

choice ZMK_DISPLAY_WORK_QUEUE
    default ZMK_DISPLAY_WORK_QUEUE_DEDICATED
endchoice

endif

if LVGL

config ZMK_DISPLAY_DEDICATED_THREAD_STACK_SIZE
	default 8192

#config LV_HOR_RES_MAX
	#default 128
#config LV_VER_RES_MAX
	#default 32
config LV_Z_VDB_SIZE
	default 64

config LV_DPI_DEF
	default 70
config LV_Z_BITS_PER_PIXEL
	default 1
choice LV_COLOR_DEPTH
	default LV_COLOR_DEPTH_1
endchoice

endif

config ZMK_WIDGET_WPM_STATUS
	default y
```

## config/boards/shields/numpadk/Kconfig.shield
```kconfig
# Copyright (c) 2020 The ZMK Contributors
# SPDX-License-Identifier: MIT

config SHIELD_NUMPADK
    def_bool $(shields_list_contains,numpadk)
```

## config/west.yml
```yaml
manifest:
  remotes:
    - name: zmkfirmware
      url-base: https://github.com/tokyo2006
    - name: inorichi
      url-base: https://github.com/inorichi
  projects:
    - name: zmk
      remote: zmkfirmware
      revision: all_feature
      import: app/west.yml
    - name: zmk-pmw3610-driver
      remote: inorichi
      revision: main
  self:
    path: config
    
```
